## main/Kconfig.projbuild
```kconfig
menu "Example Configuration"

    config EXAMPLE_TX_GPIO_NUM
        int "TX GPIO number"
        default 12 if IDF_TARGET_ESP32
        default 42 if IDF_TARGET_ESP32S3
        default 42
        help
            This option selects the GPIO pin used for the TX signal. Connect the
            TX signal to your transceiver.

    config EXAMPLE_RX_GPIO_NUM
        int "RX GPIO number"
        default 13 if IDF_TARGET_ESP32
        default 41 if IDF_TARGET_ESP32S3
        default 41
        help
            This option selects the GPIO pin used for the RX signal. Connect the
            RX signal to your transceiver.

endmenu
```
